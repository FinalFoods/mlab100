## components/mlab/Kconfig
```kconfig
menu "mlab"

choice MLAB_PLATFORM
  bool "Target platform"
  default MLAB_PLATFORM_ESP32_DEVKITC_V4
  help
      Select the target platform.

      NOTE: This might not be the best place for this functionality;
      but I have not yet found a relevant alternative.

config MLAB_PLATFORM_ESP32_DEVKITC_V4
  bool "ESP32-DevKitC V4"
config MLAB_PLATFORM_ESP32_WROVER_KIT
  bool "ESP32-WROVER-KIT"
endchoice

config MLAB_BLUFI
  bool "Enable BluFi (BLE-GATT) support"
  depends on BT_ENABLED
  help
    If enabled this option provides support for configuring the WiFi via a BluFi mobile application.

config MLAB_HTTPD
  bool "Enable HTTPD support"
  help
    If enabled this option provides a HTTPD server.

endmenu  # mlab
```
